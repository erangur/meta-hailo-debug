## conf/layer.conf
```bitbake
# We have a conf and classes directory, add to BBPATH
BBPATH .= ":${LAYERDIR}"

# We have recipes-* directories, add to BBFILES
BBFILES += "${LAYERDIR}/recipes-*/*/*.bb \
            ${LAYERDIR}/recipes-*/*/*.bbappend"

BBFILE_COLLECTIONS += "meta-hailo-debug"
BBFILE_PATTERN_meta-hailo-debug = "^${LAYERDIR}/"
BBFILE_PRIORITY_meta-hailo-debug = "7"

LAYERDEPENDS_meta-hailo-debug = "core"
LAYERSERIES_COMPAT_meta-hailo-debug = "kirkstone"


# Package Manager (opkg / apt / rpm)
#PACKAGE_CLASSES = "package_deb"
PACKAGE_CLASSES = "package_ipk"
EXTRA_IMAGE_FEATURES += " package-management "
IMAGE_INSTALL:append = " gnupg opkg "

# Gstreamer tracers + gstshark
IMAGE_INSTALL:append = " tappas-tracers gstreamer1.0 gstreamer1.0-dev gst-shark debug-profile "
PACKAGECONFIG:append:pn-gstreamer1.0 = " tracer-hooks coretracers"

# Compilers 
PREFERRED_VERSION:gcc = "11.2.0"
PREFERRED_VERSION:g++ = "11.2.0"
IMAGE_INSTALL:append = " gcc g++ "

# Tools
IMAGE_INSTALL:append = " git nano tmux wget valgrind ffmpeg emacs python3-pip cpulimit "

BBMASK += "../recipes-hailo-debug/debug-denoising/"
```
